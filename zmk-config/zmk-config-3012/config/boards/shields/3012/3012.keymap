/*
 * Copyright (c) 2022 The ZMK Contributors
 *
 * SPDX-License-Identifier: MIT
 */

#include <behaviors.dtsi>
#include <dt-bindings/zmk/keys.h>
#include <dt-bindings/zmk/bt.h>


#define DEFAULT 0
#define NUM     1


#define COMBO(NAME, BINDINGS, KEYPOS) \
  combo_##NAME { \
    timeout-ms = <50>; \
    bindings = <BINDINGS>; \
    key-positions = <KEYPOS>; \
    layers = <0,1>; \
  };

/ {
  behaviors {
    hm: homerow_mods {
      compatible = "zmk,behavior-hold-tap";
      label = "HOMEROW_MODS";
      #binding-cells = <2>;
      tapping-term-ms = <200>;
      quick-tap-ms = <0>;
      flavor = "tap-preferred";
      bindings = <&kp>, <&kp>;
    };
};

combos {
    compatible = "zmk,combos";

    COMBO(fn1, &kp FN1, 11 1)
    COMBO(fn2, &kp FN2, 11 2)
    COMBO(fn3, &kp FN3, 11 3)
    COMBO(fn4, &kp FN4, 11 4)
    COMBO(fn5, &kp FN5, 11 5)
    COMBO(fn6, &kp FN6, 0 6)
    COMBO(fn7, &kp FN7, 0 7)
    COMBO(fn8, &kp FN8, 0 8)
    COMBO(fn9, &kp FN9, 0 9)
    COMBO(fn10, &kp FN10, 0 10)
    COMBO(fn10, &kp FN11, 0 11)
    COMBO(BT 0, &bt BT_SEL 0, 0 11 24 35)
    COMBO(BT 1, &bt BT_SEL 1, 1 10 25 34)
    COMBO(BT 2, &bt BT_SEL 2, 2 9 26 33)
    COMBO(BT 3, &bt BT_SEL 3, 3 8 27 32)
    COMBO(BT 4, &bt BT_SEL 4, 4 7 28 31)
    COMBO(clrBT, &bt BT_CLR, 5 6 29 30)
    COMBO(usbTog, &out OUT_TOG, 18 19)
    COMBO(scrnUp, c_bri_up, 16 19 20)
    COMBO(scrnDn, c_bri_dn, 15 19 20)
    COMBO(VolUp, c_vol_up, 15 16 20)
    COMBO(VolDN, c_vol_dn, 15 16 19)
    COMBO(MUT, c_mute, 16 17 18 19)
    COMBO(CAPSword, &caps_word,12 23)
    CONBO(Space_Bar, &kp space, 29 30)
    COMBO(defaultLayer, &to 0, 22 23)
    COMBO(numLayer, &to 1, 34 35)
  };

    tdTabE: Tab_Esc {
      compatible = "zmk,behavior-tap-dance";
      label = "Tab_Esc";
      #binding-cells = <0>;
      tapping-term-ms = <200>;
      bindings = <&kp TAB>, <&kp ESC>;
    };

    tdqN1: Q_N1 {
      compatible = "zmk,behavior-tap-dance";
      label = "Q_N1";
      #binding-cells = <0>;
      tapping-term-ms = <200>;
      bindings = <&kp q>, <&kp N1>;
    };

    tdwN2: W_N2 {
      compatible = "zmk,behavior-tap-dance";
      label = "W_N2";
      #binding-cells = <0>;
      tapping-term-ms = <200>;
      bindings = <&kp w>, <&kp N2>;
    };

    tdEN3: E_N3 {
      compatible = "zmk,behavior-tap-dance";
      label = "E_N3";
      #binding-cells = <0>;
      tapping-term-ms = <200>;
      bindings = <&kp E>, <&kp N3>;
    };

    tdRN4: R_N4 {
      compatible = "zmk,behavior-tap-dance";
      label = "R_N4";
      #binding-cells = <0>;
      tapping-term-ms = <200>;
      bindings = <&kp r>, <&kp N4>;
    };

    tdRTN5: T_N5 {
      compatible = "zmk,behavior-tap-dance";
      label = "T_N5";
      #binding-cells = <0>;
      tapping-term-ms = <200>;
      bindings = <&kp t>, <&kp N5>;
    };

    tdYN6: Y_N6 {
      compatible = "zmk,behavior-tap-dance";
      label = "Y_N6";
      #binding-cells = <0>;
      apping-term-ms = <200>;
      bindings = <&kp y>, <&kp N6>;
    };

    tdUN7: U_N7 {
      compatible = "zmk,behavior-tap-dance";
      label = "U_N7";
      #binding-cells = <0>;
      tapping-term-ms = <200>;
      bindings = <&kp u>, <&kp N7>;
    };

    tdIN8: I_N8 {
      compatible = "zmk,behavior-tap-dance";
      label = "I_N8";
      #binding-cells = <0>;
      tapping-term-ms = <200>;
      bindings = <&kp i>, <&kp N8>;
    };

    tdON9: O_N9 {
      compatible = "zmk,behavior-tap-dance";
      label = "O_N9";
      #binding-cells = <0>;
      tapping-term-ms = <200>;
      bindings = <&kp o>, <&kp N9>;
    };

    tdPN0: P_N0 {
      compatible = "zmk,behavior-tap-dance";
      label = "P_N0";
      #binding-cells = <0>;
      tapping-term-ms = <200>;
      bindings = <&kp p>, <&kp N0>;
    };

    tdDELBSlH: DEL_BSLASH {
      compatible = "zmk,behavior-tap-dance";
      label = "DELBSLH";
      #binding-cells = <0>;
      tapping-term-ms = <200>;
      bindings = <&kp DEL>, <&kp BSLASH>;
    };

    tdaMINUS: A_MINUS {
      compatible = "zmk,behavior-tap-dance";
      label = "A_MINUS";
      #binding-cells = <0>;
      tapping-term-ms = <200>;
      bindings = <&kp a>, <&kp KP_MINUS>;
    };

    tdsPLUS: s_PLUS {
      compatible = "zmk,behavior-tap-dance";
      label = "s_PLUS";
      #binding-cells = <0>;
      tapping-term-ms = <200>;
      bindings = <&kp s>, <&kp KP_PLUS>;
    };

    tddLEFT: d_LEFT {
      compatible = "zmk,behavior-tap-dance";
      label = "d_LEFT";
      #binding-cells = <0>;
      tapping-term-ms = <200>;
      bindings = <&kp d>, <&kp LEFT>;
    };

    tdfDOWN: F_DOWN {
      compatible = "zmk,behavior-tap-dance";
      label = "F_DOWN";
      #binding-cells = <0>;
      tapping-term-ms = <200>;
      bindings = <&kp f>, <&kp DOWN>;
    };

    tdgSPACE: g_SPACE {
      compatible = "zmk,behavior-tap-dance";
      label = "g_SPACE";
      #binding-cells = <0>;
      tapping-term-ms = <200>;
      bindings = <&kp g>, <&kp SPACE>;
    };

    tdhSPACE: h_SPACE {
      compatible = "zmk,behavior-tap-dance";
      label = "h_SPACE";
      #binding-cells = <0>;
      tapping-term-ms = <200>;
      bindings = <&kp h>, <&kp SPACE>;
    };

    tdjUP: j_UP {
      compatible = "zmk,behavior-tap-dance";
      label = "j_UP";
      #binding-cells = <0>;
      tapping-term-ms = <200>;
      bindings = <&kp j>, <&kp UP>;
    };

    tdkRIGHT: k_RIGHT {
      compatible = "zmk,behavior-tap-dance";
      label = "k_RIGHT";
      #binding-cells = <0>;
      tapping-term-ms = <200>;
      bindings = <&kp k>, <&kp RIGHT>;
    };

    tdlGRAVE: l_GRAVE {
      compatible = "zmk,behavior-tap-dance";
      label = "l_GRAVE";
      #binding-cells = <0>;
      tapping-term-ms = <200>;
      bindings = <&kp l>, <&kp GRAVE>;
    };

    tdSEMIAPOS: SEMI_APOS {
      compatible = "zmk,behavior-tap-dance";
      label = "SEMI_QUO";
      #binding-cells = <0>;
      tapping-term-ms = <200>;
      bindings = <&kp SEMI>, <&kp APOS>;
    };

    tdRSHFRET: RSHIFT_RET {
      compatible = "zmk,behavior-tap-dance";
      label = "RSHIFT_RET";
      #binding-cells = <0>;
      tapping-term-ms = <200>;
      bindings = <&kp RSHIFT>, <&kp RET>;
    };

    tdzx: z_x {
      compatible = "zmk,behavior-tap-dance";
      label = "z_x";
      #binding-cells = <0>;
      tapping-term-ms = <200>;
      bindings = <&kp z>, <&kp x>;
    };

    tdcSPACE: c_SPACE {
      compatible = "zmk,behavior-tap-dance";
      label = "c_SPACE";
      #binding-cells = <0>;
      tapping-term-ms = <200>;
      bindings = <&kp c>, <&kp SPACE>;
    };

    tdvSPACE: v_SPACE {
      compatible = "zmk,behavior-tap-dance";
      label = "v_SPACE";
      #binding-cells = <0>;
      tapping-term-ms = <200>;
      bindings = <&kp z>, <&kp x>;
    };

    tdSPACEb: SPACE_b {
      compatible = "zmk,behavior-tap-dance";
      label = "SPACE_b";
      #binding-cells = <0>;
      tapping-term-ms = <200>;
      bindings = <&kp SPACE>, <&kp b>;
    };

    tdnSPACE: n_SPACE {
      compatible = "zmk,behavior-tap-dance";
      label = "n_SPACE_x";
      #binding-cells = <0>;
      tapping-term-ms = <200>;
      bindings = <&kp n>, <&kp SPACE>;
    };

    tdmSPACE: m_SPACE{
      compatible = "zmk,behavior-tap-dance";
      label = "m_SPACE";
      #binding-cells = <0>;
      tapping-term-ms = <200>;
      bindings = <&kp m>, <&kp SPACE>;
    };

    tdCOMALBKT: COMA_LBKT{
      compatible = "zmk,behavior-tap-dance";
      label = "COMA_LBKT";
      #binding-cells = <0>;
      tapping-term-ms = <200>;
      bindings = <&kp COMA>, <&kp LBKT>;
    };

    tdDOTRBKT: DOT_RBKT {
      compatible = "zmk,behavior-tap-dance";
      label = "DOT_RBKT";
      #binding-cells = <0>;
      tapping-term-ms = <200>;
      bindings = <&kp DOT>, <&kp RBKT>;
    };
};

keymap {
        compatible = "zmk,keymap";	


default_layer {
           bindings = <

&tdTABE   &tdqN1          &tdwN2        &tdeN3        &tdrN4        &tdtN5          &tdyN6           &tduN7            &tdiN8          &tdoN9       &tdpN0     &tdDELBSLH

&kb LSHFT      &td a KP_MINUS    &tdsKP_PLUS   &tddLEFT      &tdfDOWN       &tdgSPACE      &kphSPACE    &tdjUP     &tdkRIGHT    &tdlGRAVE        &tdSEMIAPOS      &td RSHFTRET

&MT LCTRL      &MT 	LALT          &MT LGUI 	     &tdxz     &tdcSPACE     &tdvSPACE      &tdSPACEb        &tdnSPACE         &tdmSPACE        &tdCOMALBKT        &tdDOTRBKT      &kp FSLH

            >;
        };	

       Num_layer {
bindings = <

&MT TAB ESC    &kp N1          &kp N2        &kp N3        &kp N4        &kp N5          &kp N6           &kp N7            &kp N8           &kp N9       &kp N0     &td DEL BSLASH


&kb LSHFT      &kp KP_MINUS    &kp KP_PLUS   &kp LEFT      &kp DOWN       &td SPACE      &kp SPACE      &kp UP       &kp RIGHT    &tdLGRAVE       &tdSEMIAPOS      &kp RETURN	


&MT LCTRL      &MT 	LALT       &MT LGUI 	 &tdxz      &kp SPACE      &kp SPACE        &kp SPACE     &kp SPACE    &kp SPACE        &td,[        &td.]      &kp FSLH

    >;
  };
 };
};
