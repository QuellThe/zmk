## zmk-config/zmk-config-3012/config/west.yml
```yaml
manifest:
  remotes:
    - name: some_name
      url-base: https://github.com/QuellThe
  projects:
    - name: zmk
      remote: some_name
      revision: main
      import: app/west.yml
  self:
    path: config
```
